/*
 * pISO.c
 *
 * Created: 12/4/2017 9:03:34 PM
 * Author : James Tate
 * Must use -Os or this may not fit
 */ 

// might have to change the default 1Mhz clock. http://www.atmel.com/images/atmel-2586-avr-8-bit-microcontroller-attiny25-attiny45-attiny85_datasheet.pdf page 30/31
#define F_CPU 1000000UL

#include <avr/io.h>

#ifdef tiny_102
#pragma message ( "tiny102" )
#include <avr/iotn102.h>
#else
#pragma message ( "tiny25" )
#include <avr/iotn25.h>
#endif

#include <util/delay.h> 
#include <avr/pgmspace.h> 

#ifdef tiny_102
#define RST			PORTA0
#define DC			PORTA1
#define CS			PORTB3
#define RST_HIGH	PORTA |= (1<<RST)
#define RST_LOW		PORTA &= ~(1<<RST)
#define DC_HIGH		PORTA |= (1<<DC)
#define DC_LOW		PORTA &= ~(1<<DC)
#define CS_HIGH		PORTB |= (1<<CS)
#define CS_LOW		PORTB &= ~(1<<CS)
#else
#pragma message ( "tiny25 defines" )
#define MOSI		PB0
#define RST			PB1
#define SCLK		PB2
#define CS			PB3
#define DC			PB4
#define RST_HIGH	PORTB |= (1<<RST)
#define RST_LOW		PORTB &= ~(1<<RST)
#define DC_HIGH		PORTB |= (1<<DC)
#define DC_LOW		PORTB &= ~(1<<DC)
#define CS_HIGH		PORTB |= (1<<CS)
#define CS_LOW		PORTB &= ~(1<<CS)
#define MOSI_HIGH		PORTB |= (1<<MOSI)
#define MOSI_LOW		PORTB &= ~(1<<MOSI)
#define SCLK_HIGH		PORTB |= (1<<SCLK)
#define SCLK_LOW		PORTB &= ~(1<<SCLK)
#endif

#define	   BUFF_SIZE			1024
#define    SETCONTRAST			0x81
#define    DISPLAYALLON_RESUME  0xA4
#define    DISPLAYALLON			0xA5
#define    NORMALDISPLAY		0xA6
#define    INVERTDISPLAY		0xA7
#define    DISPLAYOFF			0xAE
#define    DISPLAYON			0xAF
#define    SETDISPLAYOFFSET		0xD3
#define    SETCOMPINS			0xDA
#define    SETVCOMDETECT		0xDB
#define    SETDISPLAYCLOCKDIV	0xD5
#define    SETPRECHARGE			0xD9
#define    SETMULTIPLEX			0xA8
#define    SETLOWCOLUMN			0x00
#define    SETHIGHCOLUMN		0x10
#define    SETSTARTLINE			0x40
#define    MEMORYMODE			0x20
#define    COLUMNADDR			0x21
#define    PAGEADDR				0x22
#define    COMSCANINC			0xC0
#define    COMSCANDEC			0xC8
#define    SEGREMAP				0xA0
#define    CHARGEPUMP			0x8D
#define    EXTERNALVCC			0x01
#define    SWITCHCAPVCC			0x02
#define	   LCDHEIGHT            64
#define	   LCDWIDTH				128

// since we only have 32 bytes of SRAM, we have to do this in program memory
const uint8_t btm102[] PROGMEM = {
	0x00, 0x80, 0xC0, 0xE0, 0xF0, 0xF8, 0xF8, 0xFC, 0xFC, 0xFC, 0xFE, 0xFE, 0xFE, 0xFE, 0xFE, 0xFE,
	0xFE, 0xFE, 0xFE, 0xFE, 0xFE, 0xFE, 0xFE, 0xFE, 0xFE, 0xFE, 0xFE, 0xFE, 0xFE, 0xFE, 0xFE, 0xFE,
	0xFE, 0xFE, 0xFE, 0xFE, 0xFE, 0xFE, 0xFE, 0xFE, 0xFE, 0xFE, 0xFE, 0xFE, 0xFE, 0xFE, 0xFE, 0xFE,
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	0x05, 0x01, 0x04, 0x04, 0x05, 0x01, 0x01, 0x04, 0x05, 0x05, 0x01, 0x05, 0x04, 0x04, 0x05, 0x00
	};
const uint8_t btm[] PROGMEM = {
0x00, 0x00, 0x00, 0x00, 0x00, 0x00, 0x00, 0x00, 0x00, 0x00, 0x00, 0x00, 0x00, 0x00, 0x00, 0x00,
0x00, 0x00, 0x00, 0x00, 0x00, 0x00, 0x00, 0x00, 0x00, 0x00, 0x00, 0x00, 0x00, 0x00, 0x00, 0x00,
0x00, 0x00, 0x00, 0x00, 0x00, 0x00, 0x00, 0x00, 0x00, 0x00, 0x00, 0x00, 0x00, 0x04, 0x00, 0x04,
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0x0F, 0x0F, 0x0F, 0x0F, 0x07, 0x07, 0x07, 0x03, 0x03, 0x01, 0x01, 0x00, 0x00, 0x00, 0x00, 0x00
};

void toggleSPIclk(uint8_t data){
	for(char i = 0; i<8; i++){
		if(data & 0x80)
		MOSI_HIGH;
		else
		MOSI_LOW;
		SCLK_HIGH;
		data = data << 1;
		SCLK_LOW;
	}
}

void sendSPIcommand(uint8_t data){
	CS_LOW;
	// send data
	#ifdef tiny_102
	UDR = data;
	_delay_us(25);
	#else
	#pragma message ( "tiny25 commands" )
	toggleSPIclk(data);
	#endif
	CS_HIGH;
}

void sendSPIdata(uint8_t data){
	// send data
	#ifdef tiny_102
	UDR = data;
	while ( !(UCSRA & (1<<UDRE)));
	#else
	#pragma message ( "tiny25 data" )
	toggleSPIclk(data);
	#endif
}

void shutdownIO(){
	#ifdef tiny_102
	// release TX
	UCSRB = (0<<TXEN);
	// set all ports to input
	DDRA = 0;
	DDRB = 0;
	SMCR = 5;
	#else
	#pragma message ( "tiny25 shutdown" )
	DDRB = 0;
	// add logic here to look for pi waking up and taking over
	SLEEP_MODE_PWR_DOWN;
	#endif
}

int main(void)
{
	#ifdef tiny_102
	// set CS RST and DC to output
	DDRB |= 1<<CS;
	DDRA |= 1<<RST;
	DDRA |= 1<<DC;
	//set BAUD = 0
	UBRR = 0;
	// set CLK to output for master mode
	DDRB |= (1<<DDRB1);
	// Set MSPI mode of operation and SPI data mode 0. 
	UCSRC = (1<<UMSEL1) // Master SPI
		|(1<<UMSEL0);	// Master SPI
	// Enable TX 
	UCSRB = (1<<TXEN);
	// set BAUD to rate
	UBRR = 0;
	#else
	#pragma message ( "tiny25 setup" )
	// everything output
	DDRB |= (1<<RST) | (1<<DC) | (1<<CS) | (1<<MOSI) | (1<<SCLK);
	// 3 wire spi mode
	//USICR |= (1<<USIWM0);
	MOSI_LOW;
	SCLK_LOW;
	#endif
	
	RST_HIGH;
	DC_HIGH; 
	CS_HIGH;
	_delay_ms(1);
	RST_LOW;
	_delay_ms(10);
	RST_HIGH;
	_delay_ms(1);
	DC_LOW;
	sendSPIcommand(DISPLAYOFF);
	sendSPIcommand(SETDISPLAYCLOCKDIV);
	sendSPIcommand(0x80); // the suggested ratio 0x80
	sendSPIcommand(SETMULTIPLEX);
	sendSPIcommand(LCDHEIGHT - 1);
	sendSPIcommand(SETDISPLAYOFFSET | 0x0);
	sendSPIcommand(0x0);                                      // no offset
	sendSPIcommand(SETSTARTLINE); // line #0
	sendSPIcommand(CHARGEPUMP);
	sendSPIcommand(0x14);
	sendSPIcommand(MEMORYMODE);
	sendSPIcommand(0x00); // 0x0 act like ks0108
	sendSPIcommand(SEGREMAP | 0x1);
	sendSPIcommand(COMSCANDEC);
	sendSPIcommand(SETCOMPINS);
	sendSPIcommand(0x12);
	sendSPIcommand(SETCONTRAST);
	sendSPIcommand(0xCF);
	sendSPIcommand(SETPRECHARGE);
	sendSPIcommand(0xF1);
	sendSPIcommand(SETVCOMDETECT);
	sendSPIcommand(0x40);
	sendSPIcommand(DISPLAYALLON_RESUME);
	sendSPIcommand(NORMALDISPLAY);
	sendSPIcommand(DISPLAYON);
	sendSPIcommand(COLUMNADDR);
	sendSPIcommand(0);                 // Column start address. (0 = reset)
	sendSPIcommand(LCDWIDTH-1); // Column end address.
	sendSPIcommand(PAGEADDR);
	sendSPIcommand(0);                     // Page start address. (0 = reset)
	sendSPIcommand(7); // Page end address.
	
	// send data
	DC_HIGH;
	CS_LOW;
	uint16_t i = 0;
	while(i < BUFF_SIZE){
		#ifdef tiny_102
		if(i < 256)
			sendSPIdata(0x00);
		else if(i < 896)
			sendSPIdata(pgm_read_byte(&btm102[i - 256]));
		else
			sendSPIdata(0x00);
		#else
			sendSPIdata(pgm_read_byte(&btm[i]));
		#endif
		i++;
	}
	CS_HIGH;
	_delay_ms(5000);
	shutdownIO(); 
}

