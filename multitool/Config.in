## multitool/Config.in
```kconfig
config BR2_PACKAGE_MULTITOOL
	bool "multitool"
	depends on BR2_PACKAGE_WIRINGPI
	help
	  USB-multitool application

	  http://example.com
```

## pISO.old/Config.in
```kconfig
config BR2_PACKAGE_PISO
	bool "pISO"
	depends on BR2_PACKAGE_WIRINGPI
	help
	  pISO application

	  http://example.com
```

## pISO/Config.in
```kconfig
config BR2_PACKAGE_PISO
	bool "pISO"
	depends on BR2_PACKAGE_HOST_CARGO
	help
	  pISO application

	  https://www.kickstarter.com/projects/178023282/piso-the-most-versatile-flash-drive-yet
```
